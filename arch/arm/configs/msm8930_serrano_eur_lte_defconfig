## arch/arm/configs/msm8930_serrano_eur_lte_defconfig
```kconfig
CONFIG_MACH_SERRANO_EUR_LTE=y
CONFIG_WCNSS_CCX=y
# CONFIG_2MIC_QUP_I2C is not set
# CONFIG_2MIC_ES305 is not set
# CONFIG_2MIC_QUP_I2C_GSBI11 is not set
# HID
CONFIG_HID_KK_UPGRADE=y

# Battery charging and BMS
CONFIG_PM8921_BMS=y
CONFIG_PM8921_CHARGER=y
CONFIG_PM8921_SEC_CHARGER=y
CONFIG_SAMSUNG_LPM_MODE=y
# CONFIG_BATTERY_MSM is not set
CONFIG_USB_SWITCH_TSU6721=y
```
